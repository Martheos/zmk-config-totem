## config/west.yml
```yaml
manifest:
  remotes:
    - name: zmkfirmware
      url-base: https://github.com/zmkfirmware
    - name: englmaxi
      url-base: https://github.com/englmaxi
    - name: urob
      url-base: https://github.com/urob
  projects:
    - name: zmk
      remote: zmkfirmware
      revision: v0.3.0
      import: app/west.yml

    - name: zmk-tri-state
      remote: urob
      revision: main
    - name: zmk-auto-layer
      remote: urob
      revision: main
    - name: zmk-helpers
      remote: urob
      revision: main
    - name: zmk-adaptive-key
      remote: urob
      revision: main
  self:
    path: config
```
